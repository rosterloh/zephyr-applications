## applications/common/build_id/Kconfig
```kconfig
# Copyright (c) 2026 Richard Osterloh
# SPDX-License-Identifier: Apache-2.0

config APP_BUILD_ID
	bool "Embed a GNU build ID and report it"
	default y
	# native_sim links with the host's default script, which has no rodata
	# snippet hook.
	depends on !ARCH_POSIX
	help
	  Links with --build-id=sha1 and keeps the .note.gnu.build-id note in
	  rodata, so `readelf -n zephyr.elf` and the running image agree on one
	  ID. The short form is logged at boot.

if APP_BUILD_ID

config APP_BUILD_ID_MCUMGR
	bool "Report the build ID in MCUmgr os info"
	default y
	depends on MCUMGR_GRP_OS
	select MCUMGR_GRP_OS_INFO
	select MCUMGR_MGMT_NOTIFICATION_HOOKS
	select MCUMGR_GRP_OS_INFO_CUSTOM_HOOKS
	help
	  Adds format character 'g' to the os info command; `a` includes it
	  too. Over smpmgr/mcumgr: `os info -f g`.

config APP_BUILD_ID_COREDUMP
	bool "Write the build ID into every coredump"
	default y
	depends on DEBUG_COREDUMP
	depends on $(dt_nodelabel_enabled,app_coredump)
	select COREDUMP_DEVICE
	help
	  Registers a RAM copy of the build-ID note with the `app_coredump`
	  zephyr,coredump node (COREDUMP_TYPE_MEMCPY), so it is dumped as one
	  more memory block. scripts/build_id.py finds it in a dump by the
	  note's header, with no ELF needed.

endif # APP_BUILD_ID
```

## applications/common/img_confirm/Kconfig
```kconfig
# Copyright (c) 2026 Richard Osterloh
# SPDX-License-Identifier: Apache-2.0

config APP_IMG_CONFIRM
	bool "Confirm the MCUboot image only after an app-level health check"
	default y
	depends on BOOTLOADER_MCUBOOT && MCUBOOT_IMG_MANAGER
	# The deadline that reverts an image which never becomes healthy is a
	# task-watchdog channel.
	depends on APP_WATCHDOG
	help
	  A new image boots on trial. app_img_confirm_arm() gives it
	  APP_IMG_CONFIRM_TIMEOUT_MS to reach app_img_confirm(), called where
	  the application defines healthy; if it does not, the task watchdog
	  reboots the board and MCUboot reverts to the previous image. Needs a
	  revert-capable MCUboot mode (swap), not overwrite-only.

	  A confirmed image is left alone, so a manual MCUmgr confirm still
	  works and both calls are no-ops afterwards.

config APP_IMG_CONFIRM_TIMEOUT_MS
	int "Time a trial image has to become healthy (ms)"
	default 120000
	depends on APP_IMG_CONFIRM
```

## applications/common/picoros/Kconfig
```kconfig
# Copyright (c) 2026 Richard Osterloh
# SPDX-License-Identifier: Apache-2.0

menuconfig PICOROS
	bool "Pico-ROS ROS 2 client layer"
	select ZENOH_PICO
	select ZENOH_PICO_MULTI_THREAD
	select ZENOH_PICO_PUBLICATION
	select ZENOH_PICO_SUBSCRIPTION
	select ZENOH_PICO_QUERY
	select ZENOH_PICO_QUERYABLE
	select POSIX_API
	help
	  Build Pico-ROS (picoros + picoserdes) and Micro-CDR into the
	  application. Pico-ROS speaks the rmw_zenoh wire conventions -- key
	  expressions of the form <domain>/<topic>/<type>_/RIHS01_<hash>,
	  @ros2_lv liveliness tokens for discovery, and the rmw attachment
	  struct -- so a ROS 2 host running RMW_IMPLEMENTATION=rmw_zenoh_cpp
	  sees the firmware as an ordinary ROS 2 node. It replaces the
	  zenoh-bridge-ros2dds topology, in which the firmware published bare
	  CDR under rt/<topic> and a host-side bridge did the ROS mapping.

	  This does not replace zenoh-pico: picoros is a layer on top of it and
	  selects it. What it replaces is hand-written rmw glue in the
	  application.

	  POSIX_API is selected because zenoh-pico's Zephyr platform layer
	  calls clock_gettime(CLOCK_MONOTONIC), which picoros uses for the
	  rmw attachment timestamp.

	  ZENOH_PICO_QUERY and ZENOH_PICO_QUERYABLE are selected whether or not
	  the application uses ROS services: picoros.c calls z_get(),
	  z_declare_queryable() and friends from unguarded code, so building it
	  against a zenoh-pico with those features off fails to compile rather
	  than dropping the service support. See PICOROS_SERVICES.

if PICOROS

config PICOROS_SERVICES
	bool "Application uses Pico-ROS services"
	help
	  Documentation only today: the underlying zenoh-pico query and
	  queryable features are enabled unconditionally by PICOROS because
	  picoros.c does not compile without them, so turning this off saves
	  nothing. It exists so an application can state whether it declares
	  services, and so a future upstream fix that guards picoros.c's
	  service code has somewhere to hang.

config PICOROS_PARAMS
	bool "Pico-ROS parameter server"
	select PICOROS_SERVICES
	help
	  Build picoparams, which exposes the standard ROS 2 parameter
	  services (list/get/set/describe) backed by a user-supplied
	  parameter table.

# Numeric zenoh-pico tunables. These are read by the generated
# include/zenoh-pico/config.h (see mise.toml: patch-zenoh) rather than by any
# code here, which is why they live with the integration rather than in one
# application's Kconfig: zenoh-pico fails to compile if the symbols the
# generated header names do not exist.
#
# Defaults match upstream zenoh-pico's root CMakeLists.txt, except the lease
# pair, which rmw_zenohd requires.

config PICOROS_FRAG_MAX_SIZE
	int "Zenoh: maximum size for fragmented messages (bytes)"
	default 4096

config PICOROS_BATCH_UNICAST_SIZE
	int "Zenoh: maximum unicast batch size (bytes)"
	default 2048

config PICOROS_BATCH_MULTICAST_SIZE
	int "Zenoh: maximum multicast batch size (bytes)"
	default 2048

config PICOROS_SOCKET_TIMEOUT_MS
	int "Zenoh: default socket timeout (ms)"
	default 100

config PICOROS_TRANSPORT_LEASE_MS
	int "Zenoh: link lease duration announced to peers (ms)"
	default 60000
	help
	  60 s, not zenoh-pico's stock 10 s: rmw_zenohd runs with a 60 s lease
	  and a x2 expire factor, and Pico-ROS's README requires the client to
	  match. A shorter lease makes the router drop the session while the
	  node still believes it is connected.

config PICOROS_TRANSPORT_LEASE_EXPIRE_FACTOR
	int "Zenoh: session lease expire factor"
	default 2

config PICOROS_RUNTIME_MAX_TASKS
	int "Zenoh: maximum number of runtime tasks"
	default 64

config PICOROS_TRANSPORT_ACCEPT_TIMEOUT_MS
	int "Zenoh: P2P link accept timeout (ms)"
	default 1000

config PICOROS_TRANSPORT_CONNECT_TIMEOUT_MS
	int "Zenoh: P2P link connect timeout (ms)"
	default 10000

endif # PICOROS
```

## applications/common/prusa_camera/Kconfig
```kconfig
# Copyright (c) 2026 Richard Osterloh
# SPDX-License-Identifier: Apache-2.0

config PRUSA_CAMERA
	bool "Prusa camera service client"
	depends on HTTP_CLIENT && NET_SOCKETS_SOCKOPT_TLS && TLS_CREDENTIALS && JSON_LIBRARY
	help
	  Camera-info and snapshot uploads to the Prusa camera service
	  (https://camera-service.prusa3d.com/docs/), the backend of Prusa
	  Connect cameras.

if PRUSA_CAMERA

config PRUSA_CAMERA_HOST
	string "Camera service host"
	default "camera-service.prusa3d.com"

config PRUSA_CAMERA_CA_TAG
	int "First of three TLS credential tags for the service's CAs"
	default 1

config PRUSA_CAMERA_TIMEOUT_MS
	int "Request timeout (ms)"
	default 10000

module = PRUSA_CAMERA
module-str = prusa_camera
source "subsys/logging/Kconfig.template.log_config"

endif
```

## applications/common/reset_reason/Kconfig
```kconfig
# Copyright (c) 2026 Richard Osterloh
# SPDX-License-Identifier: Apache-2.0

config APP_RESET_REASON
	bool "Record why the board last reset"
	default y
	depends on $(dt_nodelabel_enabled,app_reset_reason)
	select RETAINED_MEM
	select RETENTION
	# Written from the task-watchdog timeout (ISR) and the fatal-error path,
	# where a mutex is not allowed.
	select RETAINED_MEM_MUTEX_FORCE_DISABLE if MULTITHREADING
	select RETENTION_MUTEX_FORCE_DISABLE if MULTITHREADING
	select HWINFO
	help
	  Keeps a small record in the `app_reset_reason` retention area (a
	  zephyr,retention node over memory a warm or cold reset does not clear)
	  and reports it once at the next boot: which task-watchdog channel
	  stalled, or that a fatal error happened and whether a coredump is
	  stored. A reset nobody marked is classified from hwinfo's reset cause.

	  Retained memory does not survive a power cycle; a power-on boot
	  reports only that.
```

## applications/common/watchdog/Kconfig
```kconfig
# Copyright (c) 2026 Richard Osterloh
# SPDX-License-Identifier: Apache-2.0

config APP_WATCHDOG
	bool "Enable task watchdog stall detection"
	default y
	select TASK_WDT
	select WATCHDOG
	select REBOOT
	help
	  Monitors registered tasks with Zephyr's task watchdog and reboots the
	  board if one stops being fed. The failure mode this catches is a hang
	  rather than a CPU fault, which a fatal-error handler cannot see.

	  Coverage is only as good as the channels an application registers: a
	  thread that never registers is not monitored, and a hang inside a
	  workqueue handler is invisible while the registrant keeps feeding.
	  See applications/common/watchdog/app_watchdog.h for the two usage
	  shapes and their trade-offs.

	  With the console coredump backend, a timeout also emits a coredump
	  before rebooting; the flash-partition backend cannot be written from
	  the timeout handler and is skipped.

config APP_REBOOT_ON_FATAL
	bool "Reboot on a fatal error"
	default y
	depends on APP_WATCHDOG
	# Rebooting hides test failures on native_sim.
	depends on !ARCH_POSIX
	select RESET_ON_FATAL_ERROR
	help
	  Reboot as soon as a fatal error has been logged (and any coredump
	  written), instead of halting until the hardware watchdog, if there is
	  one, resets the board CONFIG_TASK_WDT_MIN_TIMEOUT +
	  CONFIG_TASK_WDT_HW_FALLBACK_DELAY later.

	  A fault during boot becomes a reboot loop. An unconfirmed MCUboot
	  image reverts on the next reset, which ends it; a confirmed image
	  keeps looping. Acceptable for a headless device, which would
	  otherwise sit halted until power-cycled.

rsource "../reset_reason/Kconfig"
```

## applications/protective_stop/tests/api/testcase.yaml
```yaml
tests:
  protective_stop.api:
    tags:
      - protective_stop
      - pstop
      - http
    platform_allow:
      - native_sim/native/64
    integration_platforms:
      - native_sim/native/64
  # The shipped default: no password, admin routes refuse everything.
  protective_stop.api.admin_disabled:
    tags:
      - protective_stop
      - pstop
      - http
    platform_allow:
      - native_sim/native/64
    integration_platforms:
      - native_sim/native/64
    extra_configs:
      - CONFIG_PROTECTIVE_STOP_ADMIN_PASSWORD=""
```

## applications/protective_stop/tests/health/testcase.yaml
```yaml
tests:
  protective_stop.health:
    tags:
      - protective_stop
      - pstop
      - health
    platform_allow:
      - native_sim/native/64
      - waveshare_esp32_s3_eth/esp32s3/procpu/qemu
      - adafruit_qt_py_esp32c3/esp32c3/qemu
    integration_platforms:
      - native_sim/native/64
      - waveshare_esp32_s3_eth/esp32s3/procpu/qemu
      - adafruit_qt_py_esp32c3/esp32c3/qemu
```

## applications/protective_stop/tests/lockstep/testcase.yaml
```yaml
tests:
  protective_stop.lockstep:
    tags:
      - protective_stop
      - pstop
      - safety
      - lockstep
    platform_allow:
      - native_sim/native/64
    integration_platforms:
      - native_sim/native/64
```

## applications/protective_stop/tests/ring/testcase.yaml
```yaml
tests:
  protective_stop.ring:
    tags:
      - protective_stop
      - pstop
      - ring
    platform_allow:
      - native_sim/native/64
      - waveshare_esp32_s3_eth/esp32s3/procpu/qemu
      - adafruit_qt_py_esp32c3/esp32c3/qemu
    integration_platforms:
      - native_sim/native/64
      - waveshare_esp32_s3_eth/esp32s3/procpu/qemu
      - adafruit_qt_py_esp32c3/esp32c3/qemu
```

## applications/protective_stop/tests/session/testcase.yaml
```yaml
tests:
  protective_stop.session:
    tags:
      - protective_stop
      - pstop
      - session
    platform_allow:
      - native_sim/native/64
    integration_platforms:
      - native_sim/native/64
```

## applications/protective_stop/tests/settings/testcase.yaml
```yaml
tests:
  protective_stop.settings:
    tags:
      - protective_stop
      - pstop
      - settings
    # Needs flash_simulator behind ZMS.
    platform_allow:
      - native_sim/native/64
    integration_platforms:
      - native_sim/native/64
```

## applications/protective_stop/tests/verdict/testcase.yaml
```yaml
tests:
  protective_stop.verdict:
    tags:
      - protective_stop
      - pstop
      - safety
    platform_allow:
      - native_sim/native/64
      - qemu_cortex_m3
      - waveshare_esp32_s3_eth/esp32s3/procpu/qemu
      - adafruit_qt_py_esp32c3/esp32c3/qemu
    integration_platforms:
      - native_sim/native/64
      - waveshare_esp32_s3_eth/esp32s3/procpu/qemu
      - adafruit_qt_py_esp32c3/esp32c3/qemu
```

## boards/waveshare/rp2350_poe_eth/Kconfig.rp2350_poe_eth
```kconfig
# Copyright (c) 2026 Richard Osterloh
# SPDX-License-Identifier: Apache-2.0

config BOARD_RP2350_POE_ETH
	select SOC_RP2350A_M33 if BOARD_RP2350_POE_ETH_RP2350A_M33 || \
				  BOARD_RP2350_POE_ETH_RP2350A_M33_MCUBOOT
```

## boards/waveshare/rp2350_poe_eth/board.yml
```yaml
board:
  name: rp2350_poe_eth
  full_name: RP2350-POE-ETH
  vendor: waveshare
  socs:
    - name: rp2350a
      variants:
        - name: mcuboot
          cpucluster: m33
```
