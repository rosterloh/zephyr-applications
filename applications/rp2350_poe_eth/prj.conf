## CMakeLists.txt
```
cmake_minimum_required(VERSION 3.20.0)

find_package(Zephyr REQUIRED HINTS $ENV{ZEPHYR_BASE})
project(rp2350_poe_eth LANGUAGES C)

target_sources(app PRIVATE
  src/main.c
  src/app_net.c
)

target_sources_ifdef(CONFIG_APP_STATUS_LED app PRIVATE src/app_status.c)
```

## Kconfig
```
menu "RP2350-POE-ETH test application"

config APP_STATUS_LED
	bool "Drive the onboard WS2812 as a status indicator"
	default y
	depends on DT_HAS_WORLDSEMI_WS2812_RPI_PICO_PIO_ENABLED
	select LED_STRIP
	help
	  Use the WS2812 on GP25 to show boot / link / online / updating /
	  error state.

config APP_NET_READY_TIMEOUT_SEC
	int "Seconds to wait for a DHCPv4 lease before continuing"
	default 60
	range 5 600
	help
	  The application carries on after this expires, since the hawkBit
	  autohandler retries on its own and the shell stays usable.

endmenu

menu "Zephyr"
source "Kconfig.zephyr"
endmenu

module = APP
module-str = APP
source "subsys/logging/Kconfig.template.log_config"
```

## prj.conf
```kconfig
# Logging
CONFIG_LOG=y
CONFIG_APP_LOG_LEVEL_INF=y
CONFIG_LOG_BUFFER_SIZE=4096

# hawkBit needs a full libc (it uses strtol/snprintf on 64-bit types).
CONFIG_REQUIRES_FULL_LIBC=y

# --- Networking -------------------------------------------------------------
CONFIG_NETWORKING=y
CONFIG_NET_L2_ETHERNET=y
CONFIG_NET_IPV4=y
CONFIG_NET_IPV6=n
CONFIG_NET_TCP=y
CONFIG_NET_UDP=y
CONFIG_NET_SOCKETS=y
CONFIG_NET_DHCPV4=y
CONFIG_NET_MGMT=y
CONFIG_NET_MGMT_EVENT=y
CONFIG_NET_MGMT_EVENT_STACK_SIZE=2048
CONFIG_NET_CONFIG_SETTINGS=n

# The W6300 is a hardwired TCP/IP part but Zephyr drives it as a plain MAC,
# so the usual buffer counts apply.
CONFIG_NET_PKT_RX_COUNT=16
CONFIG_NET_PKT_TX_COUNT=16
CONFIG_NET_BUF_RX_COUNT=32
CONFIG_NET_BUF_TX_COUNT=32

CONFIG_DNS_RESOLVER=y
CONFIG_DNS_SERVER_IP_ADDRESSES=y
CONFIG_DNS_SERVER1="8.8.8.8"

CONFIG_HTTP_CLIENT=y
CONFIG_JSON_LIBRARY=y

# --- Flash / DFU ------------------------------------------------------------
CONFIG_FLASH=y
CONFIG_FLASH_MAP=y
CONFIG_FLASH_PAGE_LAYOUT=y
CONFIG_STREAM_FLASH=y
CONFIG_IMG_MANAGER=y
CONFIG_BOOTLOADER_MCUBOOT=y
CONFIG_MCUBOOT_GENERATE_CONFIRMED_IMAGE=y

CONFIG_NVS=y
CONFIG_SETTINGS=y
CONFIG_SETTINGS_NVS=y

CONFIG_REBOOT=y
CONFIG_HWINFO=y

# --- hawkBit ----------------------------------------------------------------
CONFIG_SMF=y
CONFIG_SMF_ANCESTOR_SUPPORT=y
CONFIG_HAWKBIT=y
CONFIG_HAWKBIT_AUTOHANDLER=y
CONFIG_HAWKBIT_POLL_INTERVAL=5
CONFIG_HAWKBIT_EVENT_CALLBACKS=y
# Mark the running image good once it has talked to the server, so MCUboot
# does not revert it on the next boot.
CONFIG_HAWKBIT_CONFIRM_IMG_ON_INIT=y

# Point these at your hawkBit instance, or set them at runtime from the shell
# (`hawkbit set addr <ip>` / `hawkbit set port <port>`).
CONFIG_HAWKBIT_SERVER="192.168.1.110"
CONFIG_HAWKBIT_PORT=8080
CONFIG_HAWKBIT_DDI_GATEWAY_SECURITY=y
CONFIG_HAWKBIT_DDI_SECURITY_TOKEN="abcd1234"

# --- Shell ------------------------------------------------------------------
CONFIG_SHELL=y
CONFIG_SHELL_STACK_SIZE=3072
CONFIG_HAWKBIT_SHELL=y
CONFIG_NET_SHELL=y
CONFIG_KERNEL_SHELL=y
CONFIG_FLASH_SHELL=y

# --- Stacks / heap ----------------------------------------------------------
CONFIG_MAIN_STACK_SIZE=4096
CONFIG_SYSTEM_WORKQUEUE_STACK_SIZE=4096
CONFIG_HEAP_MEM_POOL_SIZE=16384
CONFIG_LOG_PROCESS_THREAD_STACK_SIZE=2048

CONFIG_BUILD_OUTPUT_HEX=y
```

## src/main.c
```c
/*
 * Copyright (c) 2026 Richard Osterloh
 *
 * SPDX-License-Identifier: Apache-2.0
 *
 * Bring-up / evaluation firmware for the Waveshare RP2350-POE-ETH.
 *
 * Exercises the parts of the board that matter for a fielded PoE device:
 * the W6300 Ethernet controller, DHCPv4, MCUboot-backed hawkBit OTA and the
 * onboard status LED.
 */

#include <zephyr/kernel.h>
#include <zephyr/app_version.h>
#include <zephyr/device.h>
#include <zephyr/drivers/gpio.h>
#include <zephyr/dfu/mcuboot.h>
#include <zephyr/logging/log.h>
#include <zephyr/mgmt/hawkbit/autohandler.h>
#include <zephyr/mgmt/hawkbit/config.h>
#include <zephyr/mgmt/hawkbit/event.h>
#include <zephyr/mgmt/hawkbit/hawkbit.h>
#include <zephyr/sys/reboot.h>

#include "app_net.h"
#include "app_status.h"

LOG_MODULE_REGISTER(main, CONFIG_APP_LOG_LEVEL);

#define NET_READY_TIMEOUT K_SECONDS(CONFIG_APP_NET_READY_TIMEOUT_SEC)

static const struct gpio_dt_spec poe_detect = GPIO_DT_SPEC_GET(DT_NODELABEL(poe_detect), gpios);
static const struct gpio_dt_spec usb_detect = GPIO_DT_SPEC_GET(DT_NODELABEL(usb_detect), gpios);

static void log_power_source(void)
{
	int poe, usb;

	if (!gpio_is_ready_dt(&poe_detect) || !gpio_is_ready_dt(&usb_detect)) {
		LOG_WRN("Power sense GPIOs not ready");
		return;
	}

	if (gpio_pin_configure_dt(&poe_detect, GPIO_INPUT) < 0 ||
	    gpio_pin_configure_dt(&usb_detect, GPIO_INPUT) < 0) {
		LOG_WRN("Failed to configure power sense GPIOs");
		return;
	}

	poe = gpio_pin_get_dt(&poe_detect);
	usb = gpio_pin_get_dt(&usb_detect);

	LOG_INF("Power source: PoE=%s USB=%s", poe == 1 ? "yes" : "no", usb == 1 ? "yes" : "no");
}

#ifdef CONFIG_HAWKBIT_EVENT_CALLBACKS
static void hawkbit_event_handler(struct hawkbit_event_callback *cb, enum hawkbit_event_type event)
{
	ARG_UNUSED(cb);

	switch (event) {
	case HAWKBIT_EVENT_START_DOWNLOAD:
		LOG_INF("hawkBit: download started");
		app_status_set(APP_STATUS_UPDATING);
		break;

	case HAWKBIT_EVENT_END_DOWNLOAD:
		LOG_INF("hawkBit: download finished");
		break;

	case HAWKBIT_EVENT_UPDATE_DOWNLOADED:
		LOG_INF("hawkBit: update staged in slot 1, rebooting to apply");
		break;

	case HAWKBIT_EVENT_NO_UPDATE:
		LOG_DBG("hawkBit: no update available");
		app_status_set(APP_STATUS_ONLINE);
		break;

	case HAWKBIT_EVENT_CONFIRMED_CURRENT_IMAGE:
		LOG_INF("hawkBit: running image confirmed");
		break;

	case HAWKBIT_EVENT_ERROR_NETWORKING:
		LOG_ERR("hawkBit: networking error");
		app_status_set(APP_STATUS_ERROR);
		break;

	case HAWKBIT_EVENT_ERROR_DOWNLOAD:
		LOG_ERR("hawkBit: download error");
		app_status_set(APP_STATUS_ERROR);
		break;

	case HAWKBIT_EVENT_ERROR:
		LOG_ERR("hawkBit: generic error");
		app_status_set(APP_STATUS_ERROR);
		break;

	default:
		break;
	}
}

static HAWKBIT_EVENT_CREATE_CALLBACK(hb_cb_start_dl, hawkbit_event_handler,
				     HAWKBIT_EVENT_START_DOWNLOAD);
static HAWKBIT_EVENT_CREATE_CALLBACK(hb_cb_end_dl, hawkbit_event_handler,
				     HAWKBIT_EVENT_END_DOWNLOAD);
static HAWKBIT_EVENT_CREATE_CALLBACK(hb_cb_downloaded, hawkbit_event_handler,
				     HAWKBIT_EVENT_UPDATE_DOWNLOADED);
static HAWKBIT_EVENT_CREATE_CALLBACK(hb_cb_no_update, hawkbit_event_handler,
				     HAWKBIT_EVENT_NO_UPDATE);
static HAWKBIT_EVENT_CREATE_CALLBACK(hb_cb_confirmed, hawkbit_event_handler,
				     HAWKBIT_EVENT_CONFIRMED_CURRENT_IMAGE);
static HAWKBIT_EVENT_CREATE_CALLBACK(hb_cb_err_net, hawkbit_event_handler,
				     HAWKBIT_EVENT_ERROR_NETWORKING);
static HAWKBIT_EVENT_CREATE_CALLBACK(hb_cb_err_dl, hawkbit_event_handler,
				     HAWKBIT_EVENT_ERROR_DOWNLOAD);
static HAWKBIT_EVENT_CREATE_CALLBACK(hb_cb_err, hawkbit_event_handler, HAWKBIT_EVENT_ERROR);

static void hawkbit_register_callbacks(void)
{
	hawkbit_event_add_callback(&hb_cb_start_dl);
	hawkbit_event_add_callback(&hb_cb_end_dl);
	hawkbit_event_add_callback(&hb_cb_downloaded);
	hawkbit_event_add_callback(&hb_cb_no_update);
	hawkbit_event_add_callback(&hb_cb_confirmed);
	hawkbit_event_add_callback(&hb_cb_err_net);
	hawkbit_event_add_callback(&hb_cb_err_dl);
	hawkbit_event_add_callback(&hb_cb_err);
}
#else
static void hawkbit_register_callbacks(void)
{
}
#endif /* CONFIG_HAWKBIT_EVENT_CALLBACKS */

int main(void)
{
	int ret;

	app_status_set(APP_STATUS_BOOTING);

	LOG_INF("Waveshare RP2350-POE-ETH test application");
	LOG_INF("Firmware version " APP_VERSION_STRING ", built " __DATE__ " " __TIME__);

	log_power_source();

	ret = app_net_init();
	if (ret < 0) {
		app_status_set(APP_STATUS_ERROR);
		return ret;
	}

	ret = app_net_wait_for_address(NET_READY_TIMEOUT);
	if (ret < 0) {
		/*
		 * Keep going anyway: the autohandler retries, and the shell is
		 * still usable for diagnosing the link.
		 */
		app_status_set(APP_STATUS_ERROR);
	}

	hawkbit_register_callbacks();

	ret = hawkbit_init();
	if (ret < 0) {
		LOG_ERR("Failed to init hawkBit: %d", ret);
		app_status_set(APP_STATUS_ERROR);
		return ret;
	}

	LOG_INF("hawkBit polling %s:%d every %d minute(s)", CONFIG_HAWKBIT_SERVER,
		CONFIG_HAWKBIT_PORT, CONFIG_HAWKBIT_POLL_INTERVAL);

	hawkbit_autohandler(true);

	return 0;
}
```

## src/app_net.c
```c
/*
 * Copyright (c) 2026 Richard Osterloh
 *
 * SPDX-License-Identifier: Apache-2.0
 */

#include <zephyr/kernel.h>
#include <zephyr/logging/log.h>
#include <zephyr/net/net_if.h>
#include <zephyr/net/net_ip.h>
#include <zephyr/net/net_mgmt.h>
#include <zephyr/net/dhcpv4.h>
#include <zephyr/net/ethernet.h>

#include "app_net.h"
#include "app_status.h"

LOG_MODULE_REGISTER(app_net, CONFIG_APP_LOG_LEVEL);

#define NET_EVENTS (NET_EVENT_IPV4_ADDR_ADD | NET_EVENT_IF_UP | NET_EVENT_IF_DOWN)

static struct net_mgmt_event_callback mgmt_cb;
static K_SEM_DEFINE(got_address, 0, 1);

static void net_event_handler(struct net_mgmt_event_callback *cb, uint64_t event,
			      struct net_if *iface)
{
	ARG_UNUSED(iface);

	switch (event) {
	case NET_EVENT_IF_UP:
		LOG_INF("Ethernet link up");
		app_status_set(APP_STATUS_LINK_UP);
		break;

	case NET_EVENT_IF_DOWN:
		LOG_WRN("Ethernet link down");
		app_status_set(APP_STATUS_ERROR);
		break;

	case NET_EVENT_IPV4_ADDR_ADD: {
		char buf[NET_IPV4_ADDR_LEN];
		const struct net_if_addr *if_addr = cb->info;

		if (if_addr == NULL) {
			break;
		}

		LOG_INF("IPv4 address: %s",
			net_addr_ntop(AF_INET, &if_addr->address.in_addr, buf, sizeof(buf)));
		app_status_set(APP_STATUS_ONLINE);
		k_sem_give(&got_address);
		break;
	}

	default:
		break;
	}
}

int app_net_init(void)
{
	struct net_if *iface = net_if_get_first_by_type(&NET_L2_GET_NAME(ETHERNET));

	if (iface == NULL) {
		LOG_ERR("No Ethernet interface found");
		return -ENODEV;
	}

	net_mgmt_init_event_callback(&mgmt_cb, net_event_handler, NET_EVENTS);
	net_mgmt_add_event_callback(&mgmt_cb);

	if (!net_if_is_admin_up(iface)) {
		int ret = net_if_up(iface);

		if (ret < 0 && ret != -EALREADY) {
			LOG_ERR("Failed to bring interface up: %d", ret);
			return ret;
		}
	}

	LOG_INF("Starting DHCPv4");
	net_dhcpv4_start(iface);

	return 0;
}

int app_net_wait_for_address(k_timeout_t timeout)
{
	if (k_sem_take(&got_address, timeout) != 0) {
		LOG_ERR("Timed out waiting for a DHCPv4 lease");
		return -ETIMEDOUT;
	}

	return 0;
}
```

## src/app_net.h
```c
/*
 * Copyright (c) 2026 Richard Osterloh
 *
 * SPDX-License-Identifier: Apache-2.0
 */

#ifndef APP_NET_H_
#define APP_NET_H_

#include <zephyr/kernel.h>

/**
 * @brief Bring the W6300 interface up and start DHCPv4.
 *
 * @retval 0 on success.
 * @retval -ENODEV if no Ethernet interface was found.
 */
int app_net_init(void);

/**
 * @brief Block until DHCPv4 has leased an IPv4 address.
 *
 * @param timeout How long to wait.
 *
 * @retval 0 once an address is bound.
 * @retval -ETIMEDOUT if the lease was not obtained in time.
 */
int app_net_wait_for_address(k_timeout_t timeout);

#endif /* APP_NET_H_ */
```

## src/app_status.c
```c
/*
 * Copyright (c) 2026 Richard Osterloh
 *
 * SPDX-License-Identifier: Apache-2.0
 */

#include <zephyr/kernel.h>
#include <zephyr/device.h>
#include <zephyr/drivers/led_strip.h>
#include <zephyr/logging/log.h>

#include "app_status.h"

LOG_MODULE_REGISTER(app_status, CONFIG_APP_LOG_LEVEL);

static const struct device *const strip = DEVICE_DT_GET(DT_ALIAS(led_strip));

static const struct led_rgb status_colours[] = {
	[APP_STATUS_BOOTING] = {.r = 0x10, .g = 0x08, .b = 0x00},
	[APP_STATUS_LINK_UP] = {.r = 0x00, .g = 0x00, .b = 0x20},
	[APP_STATUS_ONLINE] = {.r = 0x00, .g = 0x20, .b = 0x00},
	[APP_STATUS_UPDATING] = {.r = 0x10, .g = 0x00, .b = 0x20},
	[APP_STATUS_ERROR] = {.r = 0x20, .g = 0x00, .b = 0x00},
};

void app_status_set(enum app_status status)
{
	struct led_rgb pixel;
	int ret;

	if (status >= ARRAY_SIZE(status_colours)) {
		return;
	}

	if (!device_is_ready(strip)) {
		LOG_DBG("status LED not ready, ignoring state %d", status);
		return;
	}

	pixel = status_colours[status];

	ret = led_strip_update_rgb(strip, &pixel, 1);
	if (ret < 0) {
		LOG_WRN("failed to update status LED: %d", ret);
	}
}
```

## src/app_status.h
```c
/*
 * Copyright (c) 2026 Richard Osterloh
 *
 * SPDX-License-Identifier: Apache-2.0
 */

#ifndef APP_STATUS_H_
#define APP_STATUS_H_

#include <zephyr/sys/util.h>

/** Coarse application state, surfaced on the onboard WS2812. */
enum app_status {
	/** Booting, no network yet. */
	APP_STATUS_BOOTING,
	/** Ethernet link is up but no IPv4 address has been leased. */
	APP_STATUS_LINK_UP,
	/** DHCPv4 bound, hawkBit polling. */
	APP_STATUS_ONLINE,
	/** An update is being downloaded. */
	APP_STATUS_UPDATING,
	/** Something went wrong; see the log. */
	APP_STATUS_ERROR,
};

/**
 * @brief Set the status indicator.
 *
 * Safe to call before the LED strip device is ready and on builds without a
 * status LED, in which case it is a no-op.
 */
#ifdef CONFIG_APP_STATUS_LED
void app_status_set(enum app_status status);
#else
static inline void app_status_set(enum app_status status)
{
	ARG_UNUSED(status);
}
#endif

#endif /* APP_STATUS_H_ */
```
