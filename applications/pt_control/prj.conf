## CMakeLists.txt
```
cmake_minimum_required(VERSION 3.20.0)

find_package(Zephyr REQUIRED HINTS $ENV{ZEPHYR_BASE})

project(pt_control)

# We always want colored gcc output
zephyr_compile_options(-fdiagnostics-color=always)

target_sources(app PRIVATE
  src/main.c
  src/app_gimbal.c
  src/app_ros_cdr.c
)

target_sources_ifdef(CONFIG_NETWORKING    app PRIVATE src/app_network.c)
target_sources_ifdef(CONFIG_APP_ZENOH     app PRIVATE src/app_zenoh.c)
target_sources_ifdef(CONFIG_APP_TIME_SYNC app PRIVATE src/app_time.c)
target_sources_ifdef(CONFIG_APP_DISPLAY   app PRIVATE src/app_display.c src/cfb_font_unscii8.c)
```

## Kconfig
```
mainmenu "Application options"

# Workaround for an upstream regression: mcumgr's img_mgmt.c references
# CONFIG_FLASH_BASE_ADDRESS, but arch/Kconfig only defines that symbol for
# ARC/ARM/ARM64/X86/RISCV/RX/OPENRISC/ARCH_POSIX — not Xtensa. ESP32 flash
# partition addresses are zero-based offsets, so 0 is the correct base.
# Remove once deps/zephyr carries the upstream fix.
config FLASH_BASE_ADDRESS
	hex
	depends on XTENSA
	default 0

menuconfig APP_DISPLAY
	bool "Enable status OLED"
	select DISPLAY
	select CHARACTER_FRAMEBUFFER
	default y
	help
	  Drives the onboard SSD1306 128x32 OLED (via the Character Frame Buffer)
	  to show the WiFi connection status / IP address.

if DNS_RESOLVER

config DNS_SERVER_IP_ADDRESSES
	default y

config DNS_SERVER1
	default "1.1.1.1"

endif # DNS_RESOLVER

menuconfig APP_ZENOH
	bool "Enable zenoh-pico publisher"
	select ZENOH_PICO
	select ZENOH_PICO_LINK_TCP
	select ZENOH_PICO_PUBLICATION
	select ZENOH_PICO_SUBSCRIPTION
	select ZENOH_PICO_MULTI_THREAD
	default y

if APP_ZENOH

config APP_ZENOH_LOCATOR
	string "Zenoh locator for the host router"
	default "tcp/192.168.1.10:7447"
	help
	  Locator string passed to z_open() as the connect endpoint. Format is
	  '<protocol>/<host>:<port>'. The host typically runs zenohd configured
	  with a matching listen endpoint, e.g. `zenohd -l tcp/0.0.0.0:7447`.

config APP_ZENOH_JOINT_STATE_KEY
	string "Zenoh key expression for the published JointState"
	default "rt/robot_joint_states"
	help
	  Zenoh key for the sensor_msgs/JointState carrying pan/tilt feedback.
	  The 'rt/' prefix is required by the zenoh-ros2dds bridge; this maps to
	  the ROS2 topic /robot_joint_states. Default matches the
	  topic_based_ros2_control TopicBasedSystem 'joint_states_topic' default,
	  so the host reads it as its state source with no param override.

config APP_ZENOH_JOINT_CMD_KEY
	string "Zenoh key expression for the subscribed JointState commands"
	default "rt/robot_joint_commands"
	help
	  Zenoh key for the sensor_msgs/JointState position commands. Maps to the
	  ROS2 topic /robot_joint_commands, matching the topic_based_ros2_control
	  'joint_commands_topic' default. The host writes pan/tilt setpoints
	  (joint names "pan_joint" and "tilt_joint", positions in radians).

config APP_ZENOH_JOINT_STATE_PUBLISH_HZ
	int "JointState publish rate in Hz"
	default 50
	range 1 200

# Numeric tunables consumed by the generated zenoh-pico/config.h (see
# poe.toml: patch-zenoh). Defaults match the upstream zenoh-pico root
# CMakeLists.txt so behaviour matches a stock build.
config APP_ZENOH_FRAG_MAX_SIZE
	int "Zenoh: maximum size for fragmented messages (bytes)"
	default 4096

config APP_ZENOH_BATCH_UNICAST_SIZE
	int "Zenoh: maximum unicast batch size (bytes)"
	default 2048

config APP_ZENOH_BATCH_MULTICAST_SIZE
	int "Zenoh: maximum multicast batch size (bytes)"
	default 2048

config APP_ZENOH_SOCKET_TIMEOUT_MS
	int "Zenoh: default socket timeout (ms)"
	default 100

config APP_ZENOH_TRANSPORT_LEASE_MS
	int "Zenoh: link lease duration announced to peers (ms)"
	default 10000

config APP_ZENOH_TRANSPORT_LEASE_EXPIRE_FACTOR
	int "Zenoh: session lease expire factor"
	default 3

config APP_ZENOH_RUNTIME_MAX_TASKS
	int "Zenoh: maximum number of runtime tasks"
	default 64

config APP_ZENOH_TRANSPORT_ACCEPT_TIMEOUT_MS
	int "Zenoh: P2P link accept timeout (ms)"
	default 1000

config APP_ZENOH_TRANSPORT_CONNECT_TIMEOUT_MS
	int "Zenoh: P2P link connect timeout (ms)"
	default 10000

endif # APP_ZENOH

menuconfig APP_TIME_SYNC
	bool "Enable SNTP time synchronization"
	default y if APP_ZENOH && NETWORKING
	depends on NETWORKING
	depends on NET_SOCKETS
	depends on DNS_RESOLVER
	select SNTP
	select NET_SOCKETS_SERVICE
	help
	  Synchronize SYS_CLOCK_REALTIME from an SNTP server. Publishers that
	  need ROS timestamps can publish immediately with a zero stamp and
	  switch to realtime stamps after the first successful sync.

if APP_TIME_SYNC

config APP_TIME_SNTP_SERVER
	string "SNTP server"
	default "pool.ntp.org"

config APP_TIME_SNTP_TIMEOUT_MS
	int "SNTP query timeout in milliseconds"
	default 3000

config APP_TIME_SNTP_RETRY_SEC
	int "SNTP retry interval after failure, in seconds"
	default 15
	range 1 3600

config APP_TIME_SNTP_RESYNC_SEC
	int "SNTP resync interval after success, in seconds"
	default 3600
	range 60 86400

endif # APP_TIME_SYNC

source "Kconfig.zephyr"
```

## sample.yaml
```
# This file is provided so that the application can be compiled using Twister,
# the Zephyr testing tool.
sample:
  description: Pan/tilt ros2_control bridge over zenoh-pico
  name: pt-control
common:
  build_only: true
  integration_platforms:
    - ros_driver
tests:
  app.default: {}
```

## prj.conf
```kconfig
# Application
CONFIG_MAIN_STACK_SIZE=3072
CONFIG_SYSTEM_WORKQUEUE_STACK_SIZE=2048
CONFIG_SHELL=y
CONFIG_REBOOT=y
CONFIG_LOG=y
CONFIG_CBPRINTF_FP_SUPPORT=y

# Shell over telnet (TCP port 23) in addition to the UART console.
# The net socket-service thread polls one array across ALL socket services
# (SMP-UDP + SNTP + telnet's 3 fds + its eventfd); the default ZVFS_POLL_MAX=4
# overflows once telnet is added, failing the thread ("register socket
# service, -5"). Raise it to cover every service.
CONFIG_SHELL_BACKEND_TELNET=y
CONFIG_ZVFS_POLL_MAX=10

# Flash and Settings (WiFi credentials are stored via the settings backend)
CONFIG_FLASH=y
CONFIG_FLASH_MAP=y
CONFIG_ZMS=y
CONFIG_SETTINGS=y

# Firmware upgrade (MCUboot OTA receiver). Build with --sysbuild to produce a
# bootable, OTA-capable image (see sysbuild.conf).
CONFIG_STREAM_FLASH=y
CONFIG_IMG_MANAGER=y
CONFIG_IMG_ERASE_PROGRESSIVELY=y
CONFIG_MCUBOOT_IMG_MANAGER=y

# MCUmgr: SMP over UDP for wireless OTA image upload and OS management.
# Upload with: mcumgr --conntype udp --connstring <ip>:1337 image upload ...
CONFIG_ZCBOR=y
CONFIG_MCUMGR=y
CONFIG_MCUMGR_GRP_IMG=y
CONFIG_MCUMGR_GRP_OS=y
CONFIG_MCUMGR_TRANSPORT_UDP=y

# Pan/tilt gimbal: UART bus servos exposed as actuators
CONFIG_ACTUATOR=y
CONFIG_ACTUATOR_SHELL=y
CONFIG_ACTUATOR_BUS_SERVO=y
CONFIG_BUS_SERVO=y
CONFIG_UART_INTERRUPT_DRIVEN=y

# zenoh-pico: publish JointState / subscribe joint commands over WiFi TCP
CONFIG_ZENOH_PICO=y
CONFIG_ZENOH_PICO_LINK_TCP=y
CONFIG_ZENOH_PICO_PUBLICATION=y
CONFIG_ZENOH_PICO_SUBSCRIPTION=y
CONFIG_ZENOH_PICO_MULTI_THREAD=y
# CDR codec (rosterloh-drivers) for encoding ROS 2 rmw payloads
CONFIG_CDR=y
CONFIG_POSIX_API=y
CONFIG_NET_SOCKETS=y
CONFIG_NET_TCP=y
CONFIG_DNS_RESOLVER=y
CONFIG_APP_TIME_SYNC=y
# zenoh-pico uses malloc (libc heap), not k_heap
CONFIG_HEAP_MEM_POOL_SIZE=4096

# Status OLED (SSD1306 128x32 on i2c0) showing WiFi/IP via the Character Frame
# Buffer. CFB, not LVGL: LVGL's monochrome init/render path hangs this panel at
# boot, and CFB is far simpler for a two-line text readout.
CONFIG_I2C=y
CONFIG_DISPLAY=y
CONFIG_CHARACTER_FRAMEBUFFER=y
# Use only the app's 8x8 unscii font (src/cfb_font_unscii8.c): 3 rows on the
# 128x32 panel and a full IP on one line. The stock 10x16/15x24/20x32 fonts
# are too large (2 rows, IP doesn't fit), so drop them to save flash.
CONFIG_CHARACTER_FRAMEBUFFER_USE_DEFAULT_FONTS=n
CONFIG_APP_DISPLAY=y

# Networking
CONFIG_NETWORKING=y
# ESP32 WiFi driver: registers the STA interface. Without this only the WiFi
# management/shell layers exist and the shell reports "No default interface
# found for type: STA". WIFI_ESP32 then auto-enables (needs hal_espressif blobs).
CONFIG_WIFI=y
CONFIG_NET_IPV4=y
CONFIG_NET_L2_ETHERNET=y
CONFIG_NET_L2_WIFI_MGMT=y
CONFIG_NET_DHCPV4=y

# WiFi connection management: conn_mgr + stored credentials, with the
# CONNECTIVITY_WIFI_MGMT implementation from the rosterloh-drivers module.
# Provision over the shell: wifi cred add -s <ssid> -k 1 -p <psk>
CONFIG_NET_CONNECTION_MANAGER=y
CONFIG_NET_CONNECTION_MANAGER_CONNECTIVITY_WIFI_MGMT=y
CONFIG_WIFI_CREDENTIALS=y
CONFIG_WIFI_CONNECTIVITY=y
CONFIG_NET_L2_WIFI_SHELL=y
```

## boards/ros_driver_esp32_procpu.overlay
```dts
/* solomon,ssd1306fb was removed; the bus-agnostic successor is solomon,ssd1306 */
&ssd1306_ssd1306_128x32 {
	compatible = "solomon,ssd1306";
};

&i2c0 {
	/* Run the bus at 400 kHz (Fast-mode), matching the rasprover-rs firmware
	 * that drives the SSD1306 correctly on this hardware. */
	clock-frequency = <400000>;
};

/* The ESP32 SoC dtsi leaves the WiFi node disabled and the ros_driver board
 * doesn't enable it; without this the WIFI_ESP32 driver never builds and the
 * WiFi shell reports "No default interface found for type: STA". */
&wifi {
	status = "okay";
};
```

## src/main.c
```c
#include <zephyr/logging/log.h>
LOG_MODULE_REGISTER(main, LOG_LEVEL_INF);

#include <zephyr/app_version.h>
#include <zephyr/kernel.h>

#include "app_display.h"
#include "app_gimbal.h"
#include "app_network.h"
#include "app_time.h"
#include "app_zenoh.h"

int main(void)
{
	LOG_INF("pt_control %s", APP_VERSION_STRING);

	app_gimbal_init();
	app_display_init();

	app_net_connect();
	if (app_net_ipv4_ready()) {
		app_time_start();
		app_zenoh_init();
	} else {
		LOG_WRN("Network unavailable; skipping time sync and zenoh "
			"(store credentials with 'wifi cred add' and reboot)");
	}

	return 0;
}
```

## src/app_display.c
```c
#include <zephyr/logging/log.h>
LOG_MODULE_REGISTER(app_display, LOG_LEVEL_INF);

#include <string.h>
#include <zephyr/device.h>
#include <zephyr/devicetree.h>
#include <zephyr/display/cfb.h>
#include <zephyr/drivers/display.h>
#include <zephyr/app_version.h>
#include <zephyr/kernel.h>
#include <zephyr/net/net_ip.h>

#include "app_display.h"

#define FW_LINE "fw: " APP_VERSION_STRING

static const struct device *const display = DEVICE_DT_GET_OR_NULL(DT_CHOSEN(zephyr_display));
static bool initialised;
static uint8_t font_idx;

/* Latest network status, rendered once the display is up. */
static bool net_known;
static bool net_connected;
static char net_ip[NET_IPV4_ADDR_LEN];

/* Pick the 8x8 unscii font: three rows on the 128x32 panel and a full IPv4
 * address (up to 15 chars) on one line. Falls back to font 0. */
static uint8_t select_font(void)
{
	uint8_t w, h;

	for (uint8_t idx = 0; cfb_get_font_size(display, idx, &w, &h) == 0; idx++) {
		if (w == 8 && h == 8) {
			return idx;
		}
	}
	return 0;
}

/* Three 8px rows spread over the 32px panel. */
static void draw_three_lines(const char *l0, const char *l1, const char *l2)
{
	cfb_framebuffer_clear(display, false);
	cfb_framebuffer_set_font(display, font_idx);
	cfb_print(display, l0, 0, 0);
	cfb_print(display, l1, 0, 11);
	cfb_print(display, l2, 0, 22);
	cfb_framebuffer_finalize(display);
}

static void render(void)
{
	if (!initialised) {
		return;
	}

	if (net_connected && net_ip[0] != '\0') {
		draw_three_lines(FW_LINE, "connected", net_ip);
	} else if (net_connected) {
		draw_three_lines(FW_LINE, "connected", "");
	} else if (net_known) {
		draw_three_lines(FW_LINE, "WiFi down", "");
	} else {
		draw_three_lines(FW_LINE, "connecting", "");
	}
}

void app_display_set_net(bool connected, const char *ip)
{
	net_known = true;
	net_connected = connected;
	if (connected && ip != NULL) {
		strncpy(net_ip, ip, sizeof(net_ip) - 1);
		net_ip[sizeof(net_ip) - 1] = '\0';
	} else {
		net_ip[0] = '\0';
	}
	render();
}

int app_display_init(void)
{
	if (!device_is_ready(display)) {
		LOG_ERR("Display device not ready");
		return -ENODEV;
	}

	if (display_set_pixel_format(display, PIXEL_FORMAT_MONO10) != 0) {
		(void)display_set_pixel_format(display, PIXEL_FORMAT_MONO01);
	}

	if (cfb_framebuffer_init(display) != 0) {
		LOG_ERR("CFB init failed");
		return -EIO;
	}

	(void)display_blanking_off(display);
	font_idx = select_font();
	initialised = true;
	render();
	LOG_INF("Display initialised");
	return 0;
}
```

## src/app_display.h
```c
#ifndef APP_DISPLAY_H
#define APP_DISPLAY_H

#include <stdbool.h>

#if IS_ENABLED(CONFIG_APP_DISPLAY)
int app_display_init(void);
/* Update the network status line: shows the IP when connected, otherwise a
 * "WiFi down" notice. Safe to call before the display finishes initialising. */
void app_display_set_net(bool connected, const char *ip);
#else
static inline int app_display_init(void)
{
	return 0;
}
static inline void app_display_set_net(bool connected, const char *ip)
{
}
#endif

#endif /* APP_DISPLAY_H */
```

## src/app_gimbal.c
```c
#include <zephyr/logging/log.h>
LOG_MODULE_REGISTER(app_gimbal, LOG_LEVEL_INF);

#include <zephyr/actuator/actuator.h>
#include <zephyr/actuator/actuator_group.h>
#include <zephyr/device.h>
#include <zephyr/devicetree.h>

#include <drivers/bus_servo.h>

#include "app_gimbal.h"

/* The pan/tilt actuators hang off the UART bus-servo controller; its nodelabel
 * is the parent of the gimbal-pan alias. */
#define SERVO_BUS_NODE DT_PARENT(DT_ALIAS(gimbal_pan))

static const struct device *const pan = DEVICE_DT_GET(DT_ALIAS(gimbal_pan));
static const struct device *const tilt = DEVICE_DT_GET(DT_ALIAS(gimbal_tilt));
static bool ready;

/* Group so a combined pan+tilt setpoint is issued as one atomic bus write
 * (native sync-write) rather than two back-to-back single-servo writes, which
 * the bus servos can drop. Index order: [0]=pan, [1]=tilt. */
ACTUATOR_GROUP_DEFINE(pan_tilt, DEVICE_DT_GET(DT_ALIAS(gimbal_pan)),
		      DEVICE_DT_GET(DT_ALIAS(gimbal_tilt)));

static bool read_joint(const struct device *dev, const char *name,
		       struct app_gimbal_joint_state *joint)
{
	struct actuator_feedback fb;

	if (actuator_read_feedback(dev, &fb) != 0 || !(fb.valid_mask & ACTUATOR_FB_POSITION)) {
		return false;
	}

	*joint = (struct app_gimbal_joint_state){
		.name = name,
		.position_rad = fb.position,
		.velocity_rad_s = (fb.valid_mask & ACTUATOR_FB_VELOCITY) ? fb.velocity : 0.0,
	};
	return true;
}

bool app_gimbal_init(void)
{
	/* Bring up the bus-servo serial interface before touching the actuators;
	 * the actuator ops fail until the parent bus is configured. */
	struct bus_servo_iface_param param = {
		.rx_timeout_us = 50000,
		.serial =
			{
				.baud = DT_PROP(DT_PARENT(SERVO_BUS_NODE), current_speed),
				.parity = UART_CFG_PARITY_NONE,
			},
	};
	int iface = bus_servo_iface_get_by_name(DEVICE_DT_NAME(SERVO_BUS_NODE));

	if (iface < 0 || bus_servo_init(iface, param) != 0) {
		LOG_ERR("servo bus init failed");
		return false;
	}

	if (!device_is_ready(pan) || !device_is_ready(tilt)) {
		LOG_ERR("gimbal devices not ready");
		return false;
	}

	if (actuator_enable(pan) != 0 || actuator_enable(tilt) != 0) {
		LOG_ERR("gimbal enable failed");
		return false;
	}

	ready = true;
	LOG_INF("gimbal ready");
	return true;
}

void app_gimbal_set_positions(float pan_rad, float tilt_rad)
{
	if (!ready) {
		return;
	}

	float pos[APP_GIMBAL_JOINT_COUNT] = {pan_rad, tilt_rad};

	if (actuator_group_set_position(&pan_tilt, pos) != 0) {
		LOG_WRN("gimbal setpoint failed");
	}
}

bool app_gimbal_read_joint_state(struct app_gimbal_joint_state joints[APP_GIMBAL_JOINT_COUNT])
{
	if (!ready || joints == NULL) {
		return false;
	}

	return read_joint(pan, "pan_joint", &joints[0]) &&
	       read_joint(tilt, "tilt_joint", &joints[1]);
}
```

## src/app_gimbal.h
```c
#ifndef __APP_GIMBAL_H__
#define __APP_GIMBAL_H__

#include <stdbool.h>

#define APP_GIMBAL_JOINT_COUNT 2

struct app_gimbal_joint_state {
	const char *name;
	double position_rad;
	double velocity_rad_s;
};

bool app_gimbal_init(void);
void app_gimbal_set_positions(float pan_rad, float tilt_rad);
bool app_gimbal_read_joint_state(struct app_gimbal_joint_state joints[APP_GIMBAL_JOINT_COUNT]);

#endif /* __APP_GIMBAL_H__ */
```

## src/app_network.c
```c
#include <zephyr/logging/log.h>
LOG_MODULE_REGISTER(app_network, LOG_LEVEL_INF);

#include <zephyr/kernel.h>
#include <zephyr/net/conn_mgr_monitor.h>
#include <zephyr/net/net_event.h>
#include <zephyr/net/net_if.h>
#include <zephyr/net/net_ip.h>
#include <zephyr/net/net_mgmt.h>

#include "app_display.h"
#include "app_network.h"

/* Connection management lives in the wifi_connectivity module (conn_mgr
 * CONNECTIVITY_WIFI_MGMT implementation); this file only tracks L4 state
 * and blocks boot until the network is up or the timeout expires.
 */

#define NET_CONNECT_TIMEOUT K_SECONDS(30)

static K_SEM_DEFINE(l4_connected_sem, 0, 1);
static atomic_t l4_connected;
static struct net_mgmt_event_callback l4_cb;
static struct net_mgmt_event_callback ipv4_cb;

static void l4_event_handler(struct net_mgmt_event_callback *cb, uint64_t mgmt_event,
			     struct net_if *iface)
{
	switch (mgmt_event) {
	case NET_EVENT_L4_CONNECTED:
		atomic_set(&l4_connected, 1);
		k_sem_give(&l4_connected_sem);
		break;
	case NET_EVENT_L4_DISCONNECTED:
		atomic_set(&l4_connected, 0);
		app_display_set_net(false, NULL);
		break;
	}
}

static void ipv4_event_handler(struct net_mgmt_event_callback *cb, uint64_t mgmt_event,
			       struct net_if *iface)
{
	if (mgmt_event != NET_EVENT_IPV4_ADDR_ADD) {
		return;
	}

	for (int i = 0; i < NET_IF_MAX_IPV4_ADDR; i++) {
		struct net_if_addr *if_addr = &iface->config.ip.ipv4->unicast[i].ipv4;
		char buf[NET_IPV4_ADDR_LEN];

		if (!if_addr->is_used || if_addr->addr_type != NET_ADDR_DHCP) {
			continue;
		}

		net_addr_ntop(AF_INET, &if_addr->address.in_addr, buf, sizeof(buf));
		LOG_INF("IPv4 address: %s", buf);
		app_display_set_net(true, buf);
	}
}

void app_net_connect(void)
{
	net_mgmt_init_event_callback(&l4_cb, l4_event_handler,
				     NET_EVENT_L4_CONNECTED | NET_EVENT_L4_DISCONNECTED);
	net_mgmt_add_event_callback(&l4_cb);

	net_mgmt_init_event_callback(&ipv4_cb, ipv4_event_handler, NET_EVENT_IPV4_ADDR_ADD);
	net_mgmt_add_event_callback(&ipv4_cb);

	/* Do NOT call conn_mgr_all_if_connect() here. The wifi_connectivity module
	 * owns the connection lifecycle: it sets NO_AUTO_CONNECT and drives a
	 * deferred connect from its own work queue to dodge the ESP32 boot race.
	 * Forcing an early connect makes the interface associate first, then the
	 * module's deferred attempt issues CONNECT_STORED while already connected,
	 * which the driver rejects and turns into a "Connection attempt failed (1)"
	 * reconnect loop every RECONNECT_DELAY. Just wait for L4 instead.
	 */
	conn_mgr_mon_resend_status();

	LOG_INF("Waiting for network connectivity");
	if (k_sem_take(&l4_connected_sem, NET_CONNECT_TIMEOUT)) {
		LOG_WRN("Network not ready; continuing without it "
			"(store credentials with 'wifi cred add')");
	}
}

bool app_net_ipv4_ready(void)
{
	return atomic_get(&l4_connected) != 0;
}
```

## src/app_ros_cdr.c
```c
#include "app_ros_cdr.h"

#include <string.h>
#include <zephyr/cdr/cdr.h>

#define JOINT_CMD_MAX_NAMES 8

static void encode_header(struct cdr_writer *w, struct app_ros_time stamp)
{
	cdr_write_encapsulation(w);
	cdr_write_u32(w, stamp.sec);
	cdr_write_u32(w, stamp.nanosec);
	cdr_write_string(w, ""); /* frame_id */
}

size_t app_ros_encode_joint_state(uint8_t *buf, size_t buf_size, struct app_ros_time stamp,
				  const struct app_ros_joint_sample *joints, size_t joint_count)
{
	struct cdr_writer w;

	if (joints == NULL && joint_count != 0) {
		return 0;
	}

	cdr_writer_init(&w, buf, buf_size);
	encode_header(&w, stamp);

	cdr_write_u32(&w, (uint32_t)joint_count);
	for (size_t i = 0; i < joint_count; i++) {
		if (joints[i].name == NULL) {
			return 0;
		}
		cdr_write_string(&w, joints[i].name);
	}

	cdr_write_u32(&w, (uint32_t)joint_count);
	for (size_t i = 0; i < joint_count; i++) {
		cdr_write_f64(&w, joints[i].position);
	}

	cdr_write_u32(&w, (uint32_t)joint_count);
	for (size_t i = 0; i < joint_count; i++) {
		cdr_write_f64(&w, joints[i].velocity);
	}

	cdr_write_u32(&w, 0); /* effort */

	return cdr_writer_finish(&w);
}

bool app_ros_decode_joint_command(const uint8_t *buf, size_t len, struct app_ros_joint_command *out)
{
	bool is_pan[JOINT_CMD_MAX_NAMES] = {0};
	bool is_tilt[JOINT_CMD_MAX_NAMES] = {0};

	if (buf == NULL || out == NULL) {
		return false;
	}

	struct cdr_reader r;

	cdr_reader_init(&r, buf, len);
	if (!cdr_read_encapsulation(&r)) {
		return false;
	}

	struct app_ros_joint_command cmd = {0};

	(void)cdr_read_u32(&r); /* stamp.sec */
	(void)cdr_read_u32(&r); /* stamp.nanosec */
	cdr_skip_string(&r);    /* frame_id */

	uint32_t name_count = cdr_read_u32(&r);

	if (!cdr_reader_ok(&r) || name_count > JOINT_CMD_MAX_NAMES) {
		return false;
	}

	for (uint32_t i = 0; i < name_count; i++) {
		const char *name;
		uint32_t name_len;

		if (!cdr_read_string_ref(&r, &name, &name_len)) {
			return false;
		}
		is_pan[i] = (name_len == sizeof("pan_joint")) &&
			    (memcmp(name, "pan_joint", name_len) == 0);
		is_tilt[i] = (name_len == sizeof("tilt_joint")) &&
			     (memcmp(name, "tilt_joint", name_len) == 0);
	}

	uint32_t position_count = cdr_read_u32(&r);

	if (!cdr_reader_ok(&r) || position_count != name_count) {
		return false;
	}

	for (uint32_t i = 0; i < position_count; i++) {
		double position = cdr_read_f64(&r);

		if (!cdr_reader_ok(&r)) {
			return false;
		}
		if (is_pan[i]) {
			cmd.has_pan = true;
			cmd.pan_position = position;
		}
		if (is_tilt[i]) {
			cmd.has_tilt = true;
			cmd.tilt_position = position;
		}
	}

	if (!cmd.has_pan || !cmd.has_tilt) {
		return false;
	}

	*out = cmd;
	return true;
}
```

## src/app_ros_cdr.h
```c
#ifndef APP_ROS_CDR_H
#define APP_ROS_CDR_H

#include <stdbool.h>
#include <stddef.h>
#include <stdint.h>

struct app_ros_time {
	uint32_t sec;
	uint32_t nanosec;
};

struct app_ros_joint_sample {
	const char *name;
	double position;
	double velocity;
};

struct app_ros_joint_command {
	bool has_pan;
	bool has_tilt;
	double pan_position;
	double tilt_position;
};

size_t app_ros_encode_joint_state(uint8_t *buf, size_t buf_size, struct app_ros_time stamp,
				  const struct app_ros_joint_sample *joints, size_t joint_count);

bool app_ros_decode_joint_command(const uint8_t *buf, size_t len,
				  struct app_ros_joint_command *out);

#endif /* APP_ROS_CDR_H */
```

## src/app_time.c
```c
#include <zephyr/logging/log.h>
LOG_MODULE_REGISTER(app_time, LOG_LEVEL_INF);

#include <limits.h>
#include <string.h>
#include <time.h>
#include <zephyr/kernel.h>
#include <zephyr/net/dns_resolve.h>
#include <zephyr/net/net_ip.h>
#include <zephyr/net/sntp.h>
#include <zephyr/sys/atomic.h>
#include <zephyr/sys/clock.h>

#include "app_network.h"
#include "app_time.h"

#define SNTP_SERVER_PORT 123

static void sync_work_handler(struct k_work *work);
static void sntp_timeout_handler(struct k_work *work);
static void sntp_service_handler(struct net_socket_service_event *event);

K_WORK_DELAYABLE_DEFINE(sync_work, sync_work_handler);
K_WORK_DELAYABLE_DEFINE(sntp_timeout_work, sntp_timeout_handler);
NET_SOCKET_SERVICE_SYNC_DEFINE_STATIC(sntp_service, sntp_service_handler, 1);

static struct sntp_ctx sntp_ctx;
static struct net_sockaddr_storage sntp_addr;
static net_socklen_t sntp_addrlen;
static atomic_t started;
static atomic_t synced;

static uint32_t sntp_fraction_to_nsec(uint32_t fraction)
{
	return (uint32_t)(((uint64_t)fraction * NSEC_PER_SEC) >> 32);
}

static void schedule_next(bool success)
{
	k_work_reschedule(&sync_work, K_SECONDS(success ? CONFIG_APP_TIME_SNTP_RESYNC_SEC
							: CONFIG_APP_TIME_SNTP_RETRY_SEC));
}

static bool set_clock_from_sntp(const struct sntp_time *sntp_ts)
{
	struct timespec tspec;
	int ret;

	if (sntp_ts->seconds > LONG_MAX) {
		LOG_WRN("SNTP seconds value is out of range");
		return false;
	}

	tspec.tv_sec = (time_t)sntp_ts->seconds;
	tspec.tv_nsec = (long)sntp_fraction_to_nsec(sntp_ts->fraction);

	ret = sys_clock_settime(SYS_CLOCK_REALTIME, &tspec);
	if (ret < 0) {
		LOG_WRN("setting realtime clock failed: %d", ret);
		return false;
	}

	atomic_set(&synced, 1);
	LOG_INF("time synced via SNTP server %s", CONFIG_APP_TIME_SNTP_SERVER);
	return true;
}

static int start_sntp_query(struct net_sockaddr *addr, net_socklen_t addrlen)
{
	int ret;

	ret = sntp_init_async(&sntp_ctx, addr, addrlen, &sntp_service);
	if (ret < 0) {
		LOG_WRN("SNTP init failed: %d", ret);
		return ret;
	}

	ret = sntp_send_async(&sntp_ctx);
	if (ret < 0) {
		LOG_WRN("SNTP send failed: %d", ret);
		sntp_close_async(&sntp_service);
		return ret;
	}

	k_work_reschedule(&sntp_timeout_work, K_MSEC(CONFIG_APP_TIME_SNTP_TIMEOUT_MS));
	return 0;
}

static bool parse_sntp_server_addr(void)
{
	memset(&sntp_addr, 0, sizeof(sntp_addr));
	sntp_addrlen = 0;

	if (!net_ipaddr_parse(CONFIG_APP_TIME_SNTP_SERVER, sizeof(CONFIG_APP_TIME_SNTP_SERVER) - 1,
			      net_sad(&sntp_addr))) {
		return false;
	}

	if (IS_ENABLED(CONFIG_NET_IPV4) && sntp_addr.ss_family == NET_AF_INET) {
		sntp_addrlen = sizeof(struct net_sockaddr_in);
	} else if (IS_ENABLED(CONFIG_NET_IPV6) && sntp_addr.ss_family == NET_AF_INET6) {
		sntp_addrlen = sizeof(struct net_sockaddr_in6);
	} else {
		return false;
	}

	return net_port_set_default(net_sad(&sntp_addr), SNTP_SERVER_PORT) == 0;
}

static void dns_result_cb(enum dns_resolve_status status, struct dns_addrinfo *info,
			  void *user_data)
{
	ARG_UNUSED(user_data);

	if (status == DNS_EAI_CANCELED || status == DNS_EAI_FAIL) {
		LOG_WRN("DNS query for SNTP server failed");
		schedule_next(false);
		return;
	}

	if (status == DNS_EAI_ALLDONE) {
		if (sntp_addrlen == 0) {
			LOG_WRN("DNS query for SNTP server returned no IPv4 address");
			schedule_next(false);
			return;
		}

		if (start_sntp_query(net_sad(&sntp_addr), sntp_addrlen) < 0) {
			schedule_next(false);
		}
		return;
	}

	if (status != DNS_EAI_INPROGRESS || info == NULL || sntp_addrlen != 0) {
		return;
	}

	if (IS_ENABLED(CONFIG_NET_IPV4) && info->ai_family == NET_AF_INET) {
		memset(&sntp_addr, 0, sizeof(sntp_addr));
		sntp_addrlen = info->ai_addrlen;
		sntp_addr.ss_family = NET_AF_INET;
		net_ipv4_addr_copy_raw(net_sin(net_sad(&sntp_addr))->sin_addr.s4_addr,
				       net_sin(&info->ai_addr)->sin_addr.s4_addr);
		(void)net_port_set_default(net_sad(&sntp_addr), SNTP_SERVER_PORT);
	}
}

static void sync_work_handler(struct k_work *work)
{
	int ret;

	ARG_UNUSED(work);

	if (!app_net_ipv4_ready()) {
		LOG_DBG("network is not ready for SNTP");
		schedule_next(false);
		return;
	}

	if (parse_sntp_server_addr()) {
		if (start_sntp_query(net_sad(&sntp_addr), sntp_addrlen) < 0) {
			schedule_next(false);
		}
		return;
	}

	memset(&sntp_addr, 0, sizeof(sntp_addr));
	sntp_addrlen = 0;
	ret = dns_get_addr_info(CONFIG_APP_TIME_SNTP_SERVER, DNS_QUERY_TYPE_A, NULL, dns_result_cb,
				NULL, CONFIG_APP_TIME_SNTP_TIMEOUT_MS);
	if (ret < 0) {
		LOG_WRN("DNS query for SNTP server could not start: %d", ret);
		schedule_next(false);
	}
}

static void sntp_timeout_handler(struct k_work *work)
{
	ARG_UNUSED(work);

	LOG_WRN("SNTP query timed out");
	sntp_close_async(&sntp_service);
	schedule_next(false);
}

static void sntp_service_handler(struct net_socket_service_event *event)
{
	struct sntp_time sntp_ts;
	bool success = false;
	int ret;

	ret = sntp_read_async(event, &sntp_ts);
	if (ret < 0) {
		LOG_WRN("SNTP read failed: %d", ret);
	} else {
		success = set_clock_from_sntp(&sntp_ts);
	}

	sntp_close_async(&sntp_service);
	k_work_cancel_delayable(&sntp_timeout_work);
	schedule_next(success);
}

void app_time_start(void)
{
	if (!atomic_cas(&started, 0, 1)) {
		return;
	}

	k_work_schedule(&sync_work, K_NO_WAIT);
}

bool app_time_synced(void)
{
	return atomic_get(&synced) != 0;
}

struct app_ros_time app_time_now(void)
{
	struct timespec tspec;

	if (!app_time_synced()) {
		return (struct app_ros_time){0};
	}

	if (sys_clock_gettime(SYS_CLOCK_REALTIME, &tspec) < 0 || tspec.tv_sec < 0 ||
	    tspec.tv_sec > UINT32_MAX || tspec.tv_nsec < 0 || tspec.tv_nsec >= NSEC_PER_SEC) {
		return (struct app_ros_time){0};
	}

	return (struct app_ros_time){
		.sec = (uint32_t)tspec.tv_sec,
		.nanosec = (uint32_t)tspec.tv_nsec,
	};
}
```

## src/app_zenoh.c
```c
#include <zephyr/logging/log.h>
LOG_MODULE_REGISTER(app_zenoh, LOG_LEVEL_INF);

#include <zenoh-pico.h>
#include <zephyr/kernel.h>

#include "app_gimbal.h"
#include "app_ros_cdr.h"
#include "app_time.h"
#include "app_zenoh.h"

#define JOINT_STATE_KEY          CONFIG_APP_ZENOH_JOINT_STATE_KEY
#define JOINT_CMD_KEY            CONFIG_APP_ZENOH_JOINT_CMD_KEY
#define CDR_JOINT_STATE_MAX_SIZE 256
#define JOINT_STATE_INTERVAL_MS  (1000 / CONFIG_APP_ZENOH_JOINT_STATE_PUBLISH_HZ)

static z_owned_session_t _session;
static z_owned_publisher_t _pub_joint_state;
static z_owned_subscriber_t _sub_joint_cmd;
static struct k_work_delayable _joint_state_work;
static bool _joint_state_ready;
static bool _ready;

static bool declare_cdr_publisher(z_owned_publisher_t *pub, const char *key)
{
	z_view_keyexpr_t ke;
	z_view_keyexpr_from_str_unchecked(&ke, key);

	z_publisher_options_t pub_opts;
	z_publisher_options_default(&pub_opts);

	z_owned_encoding_t enc;
	z_encoding_from_str(&enc, "application/cdr");
	pub_opts.encoding = z_move(enc);

	if (z_declare_publisher(z_loan(_session), pub, z_loan(ke), &pub_opts) < 0) {
		LOG_ERR("zenoh publisher declare failed for '%s'", key);
		return false;
	}

	return true;
}

static void joint_cmd_handler(z_loaned_sample_t *sample, void *arg)
{
	ARG_UNUSED(arg);

	z_owned_slice_t slice;

	if (z_bytes_to_slice(z_sample_payload(sample), &slice) < 0) {
		return;
	}

	const uint8_t *buf = z_slice_data(z_loan(slice));
	size_t len = z_slice_len(z_loan(slice));
	struct app_ros_joint_command cmd;

	if (!app_ros_decode_joint_command(buf, len, &cmd)) {
		LOG_WRN("joint_commands: bad JointState payload (len %zu)", len);
		z_drop(z_move(slice));
		return;
	}
	z_drop(z_move(slice));

	app_gimbal_set_positions((float)cmd.pan_position, (float)cmd.tilt_position);
}

static bool declare_joint_cmd_subscriber(void)
{
	z_view_keyexpr_t ke;
	z_view_keyexpr_from_str_unchecked(&ke, JOINT_CMD_KEY);

	z_owned_closure_sample_t callback;
	z_closure(&callback, joint_cmd_handler, NULL, NULL);

	if (z_declare_subscriber(z_loan(_session), &_sub_joint_cmd, z_loan(ke), z_move(callback),
				 NULL) < 0) {
		LOG_ERR("zenoh subscriber declare failed for '%s'", JOINT_CMD_KEY);
		return false;
	}

	LOG_INF("zenoh subscribed to '%s'", JOINT_CMD_KEY);
	return true;
}

static void joint_state_work_handler(struct k_work *work)
{
	ARG_UNUSED(work);

	if (!_ready || !_joint_state_ready) {
		goto reschedule;
	}

	struct app_gimbal_joint_state gimbal_joints[APP_GIMBAL_JOINT_COUNT];

	if (!app_gimbal_read_joint_state(gimbal_joints)) {
		LOG_WRN("gimbal joint feedback unavailable");
		goto reschedule;
	}

	struct app_ros_joint_sample joints[APP_GIMBAL_JOINT_COUNT];
	uint8_t buf[CDR_JOINT_STATE_MAX_SIZE];

	for (size_t i = 0; i < ARRAY_SIZE(gimbal_joints); i++) {
		joints[i] = (struct app_ros_joint_sample){
			.name = gimbal_joints[i].name,
			.position = gimbal_joints[i].position_rad,
			.velocity = gimbal_joints[i].velocity_rad_s,
		};
	}

	size_t len = app_ros_encode_joint_state(buf, sizeof(buf), app_time_now(), joints,
						ARRAY_SIZE(joints));
	if (len == 0) {
		LOG_WRN("joint_states encode failed");
	} else {
		z_owned_bytes_t payload;

		z_bytes_copy_from_buf(&payload, buf, len);
		if (z_publisher_put(z_loan(_pub_joint_state), z_move(payload), NULL) < 0) {
			LOG_WRN("joint_states publish failed");
		}
	}

reschedule:
	k_work_reschedule(&_joint_state_work, K_MSEC(JOINT_STATE_INTERVAL_MS));
}

bool app_zenoh_init(void)
{
	LOG_INF("zenoh connecting via %s", CONFIG_APP_ZENOH_LOCATOR);

	z_owned_config_t cfg;
	z_config_default(&cfg);
	zp_config_insert(z_loan_mut(cfg), Z_CONFIG_MODE_KEY, "client");
	zp_config_insert(z_loan_mut(cfg), Z_CONFIG_CONNECT_KEY, CONFIG_APP_ZENOH_LOCATOR);

	if (z_open(&_session, z_move(cfg), NULL) < 0) {
		LOG_ERR("zenoh session open failed");
		return false;
	}

	zp_start_read_task(z_loan_mut(_session), NULL);
	zp_start_lease_task(z_loan_mut(_session), NULL);

	if (declare_cdr_publisher(&_pub_joint_state, JOINT_STATE_KEY)) {
		_joint_state_ready = true;
		k_work_init_delayable(&_joint_state_work, joint_state_work_handler);
	} else {
		LOG_WRN("continuing without joint_states publisher");
	}

	if (!declare_joint_cmd_subscriber()) {
		LOG_WRN("continuing without joint_commands subscription");
	}

	_ready = true;
	if (_joint_state_ready) {
		k_work_schedule(&_joint_state_work, K_NO_WAIT);
	}
	LOG_INF("zenoh ready, publishing JointState to '%s', commands on '%s'", JOINT_STATE_KEY,
		JOINT_CMD_KEY);
	return true;
}
```

## src/app_zenoh.h
```c
#ifndef APP_ZENOH_H
#define APP_ZENOH_H

#include <stdbool.h>

#if IS_ENABLED(CONFIG_APP_ZENOH)
bool app_zenoh_init(void);
#else
static inline bool app_zenoh_init(void)
{
	return false;
}
#endif

#endif /* APP_ZENOH_H */
```
