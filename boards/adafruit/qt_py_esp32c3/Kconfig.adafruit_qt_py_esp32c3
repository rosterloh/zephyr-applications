## boards/adafruit/qt_py_esp32c3/Kconfig.adafruit_qt_py_esp32c3
```kconfig
# Adafruit Qt Py ESP32C3 board configuration

# Copyright (c) 2025 Richard Osterloh

config BOARD_ADAFRUIT_QT_PY_ESP32C3
	select SOC_ESP32C3_FN4
```

## boards/robotis/openrb_150/Kconfig.robotis_openrb_150
```kconfig
# Copyright (c) 2024 Richard Osterloh <richard.osterloh@gmail.com>
# SPDX-License-Identifier: Apache-2.0
config BOARD_ROBOTIS_OPENRB_150
	select SOC_SAMD21G18A
```

## boards/robotis/openrb_150/board.yml
```yaml
board:
  name: robotis_openrb_150
  full_name: Robotis OpenRB-150
  vendor: robotis
  socs:
    - name: samd21g18a
```
